## src/mainboard/fujitsu/Kconfig
```kconfig
if VENDOR_FUJITSU

choice
	prompt "Mainboard model"

source "src/mainboard/fujitsu/*/Kconfig.name"

endchoice

source "src/mainboard/fujitsu/*/Kconfig"

config MAINBOARD_VENDOR
	string
	default "FUJITSU"

endif # VENDOR_FUJITSU
```

## src/mainboard/fujitsu/lifebook_e734/Kconfig
```kconfig
if BOARD_FUJITSU_LIFEBOOK_E734

config BOARD_SPECIFIC_OPTIONS
	def_bool y
	select CPU_INTEL_HASWELL
	select NORTHBRIDGE_INTEL_HASWELL
	select SOUTHBRIDGE_INTEL_LYNXPOINT
	select INTEL_LYNXPOINT_LP
	select INTEL_INT15
	select INTEL_GMA_HAVE_VBT
	select BOARD_ROMSIZE_KB_5120
	select HAVE_ACPI_TABLES
	select HAVE_ACPI_RESUME
	select EC_ACPI
	select MAINBOARD_HAS_LIBGFXINIT # FIXME: check this
	select MAINBOARD_USES_IFD_GBE_REGION
	select SERIRQ_CONTINUOUS_MODE
	select SYSTEM_TYPE_LAPTOP
	select MAINBOARD_HAS_TPM1

config MAINBOARD_DIR
	string
	default fujitsu/lifebook_e734

config MAINBOARD_PART_NUMBER
	string
	default "LIFEBOOK E734"

config VGA_BIOS_FILE
	string
	default "pci8086,0416.rom"

config VGA_BIOS_ID
	string
	default "8086,0416"

config MAINBOARD_PCI_SUBSYSTEM_VENDOR_ID
	hex
	default 0x10cf

config MAINBOARD_PCI_SUBSYSTEM_DEVICE_ID
	hex
	default 0x17a6

config MAX_CPUS
	int
	default 8

config USBDEBUG_HCD_INDEX # FIXME: check this
	int
	default 2
endif
```

## src/mainboard/gigabyte/p34g-v2/Kconfig
```kconfig
if BOARD_GIGABYTE_P34G_V2

config BOARD_SPECIFIC_OPTIONS
	def_bool y
	select CPU_INTEL_HASWELL
	select NORTHBRIDGE_INTEL_HASWELL
	select SOUTHBRIDGE_INTEL_LYNXPOINT
	select INTEL_INT15
	select INTEL_GMA_HAVE_VBT
	select BOARD_ROMSIZE_KB_8192
	select HAVE_ACPI_TABLES
	select HAVE_ACPI_RESUME
	select EC_ACPI
	select SUPERIO_ITE_IT8587E
	select MAINBOARD_HAS_LIBGFXINIT
	select SERIRQ_CONTINUOUS_MODE
	select SYSTEM_TYPE_LAPTOP
	select TSC_MONOTONIC_TIMER

config MAINBOARD_DIR
	string
	default gigabyte/p34g-v2

config GFX_GMA_CPU_VARIANT
	string
	default "Normal"

config MAINBOARD_PART_NUMBER
	string
	default "P34G_V2"

config VGA_BIOS_FILE
	string
	default "pci8086,0416.rom"

config VGA_BIOS_ID
	string
	default "8086,0416"

config MAINBOARD_PCI_SUBSYSTEM_DEVICE_ID
	hex
	default 0xa456

config MAINBOARD_PCI_SUBSYSTEM_VENDOR_ID
	hex
	default 0x1458

config MAX_CPUS
	int
	default 8

config USBDEBUG_HCD_INDEX # FIXME: check this
	int
	default 2
endif
```

## src/mainboard/gigabyte/p34v2/Kconfig
```kconfig
##
## This file is part of the coreboot project.
##
## Copyright (C) 2018 Tristan Corrick <tristan@corrick.kiwi>
##
## This program is free software: you can redistribute it and/or modify
## it under the terms of the GNU General Public License as published by
## the Free Software Foundation, either version 2 of the License, or
## (at your option) any later version.
##
## This program is distributed in the hope that it will be useful,
## but WITHOUT ANY WARRANTY; without even the implied warranty of
## MERCHANTABILITY or FITNESS FOR A PARTICULAR PURPOSE.  See the
## GNU General Public License for more details.
##

if BOARD_SUPERMICRO_X10SLM_PLUS_F

config BOARD_SPECIFIC_OPTIONS
	def_bool y
	select BOARD_ROMSIZE_KB_8192
	select CPU_INTEL_HASWELL
	select HAVE_ACPI_RESUME
	select HAVE_ACPI_TABLES
	select HAVE_OPTION_TABLE
	select HAVE_CMOS_DEFAULT
	select NORTHBRIDGE_INTEL_HASWELL
	select SERIRQ_CONTINUOUS_MODE
	select SOUTHBRIDGE_INTEL_LYNXPOINT
        ## TODO: find EC
	#select SUPERIO_NUVOTON_NCT6776
	#select SUPERIO_NUVOTON_NCT6776_COM_A
	select TSC_MONOTONIC_TIMER

config CBFS_SIZE
	hex
	default 0x100000

config MAINBOARD_DIR
	string
	default "gigabyte/p34v2"

config MAINBOARD_PART_NUMBER
	string
	default "P34V2"

config MAINBOARD_PCI_SUBSYSTEM_DEVICE_ID
	hex
        # TODO
	default 0x0803

config MAINBOARD_PCI_SUBSYSTEM_VENDOR_ID
	hex
        # TODO
	default 0x15d9

config MAX_CPUS
	int
	default 4

endif
```

## src/mainboard/hp/2530p/Kconfig
```kconfig
#
# This file is part of the coreboot project.
#
# Copyright (C) 2017 Iru Cai <mytbk920423@gmail.com>
#
# This program is free software; you can redistribute it and/or modify
# it under the terms of the GNU General Public License as published by
# the Free Software Foundation; version 2 of the License.
#
# This program is distributed in the hope that it will be useful,
# but WITHOUT ANY WARRANTY; without even the implied warranty of
# MERCHANTABILITY or FITNESS FOR A PARTICULAR PURPOSE.  See the
# GNU General Public License for more details.
#

if BOARD_HP_2530P

#        select EC_ACPI ?
#	select USE_NATIVE_RAMINIT ?
#	SUPERIO_SMSC_KBC1100 ?
config BOARD_SPECIFIC_OPTIONS
	def_bool y
	select SYSTEM_TYPE_LAPTOP
        select CPU_INTEL_SOCKET_BGA956
	select BOARD_ROMSIZE_KB_4096
	select NORTHBRIDGE_INTEL_GM45
	select SOUTHBRIDGE_INTEL_I82801IX
	select HAVE_ACPI_TABLES
	select HAVE_OPTION_TABLE
	select HAVE_CMOS_DEFAULT
	select HAVE_ACPI_RESUME
	select INTEL_INT15
	select GFX_GMA_INTERNAL_IS_LVDS
        select EC_HP_KBC1126
	select MAINBOARD_HAS_LIBGFXINIT
	select MAINBOARD_USES_IFD_GBE_REGION

config MAINBOARD_DIR
	string
	default hp/2530p

config MAINBOARD_PART_NUMBER
	string
	default "EliteBook 2530p"

config USBDEBUG_HCD_INDEX
	int
	default 2

config MAX_CPUS
	int
	default 2
endif
```
